/dts-v1/;

/ {
    #address-cells = <1>;
    #size-cells = <2>;  

    C1: child@1 {
        #interrupt-cells = <3>;
        C2: child@2 {
            #address-cells = <4>;
            C3: child@3 {
                #size-cells = <0>;
                #interrupt-cells = <0>;
            };
        };
    };
};