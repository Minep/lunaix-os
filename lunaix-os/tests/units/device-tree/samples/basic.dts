/dts-v1/;

/ {
    compatible = "root";
    #address-cells = <1>;
    #size-cells = <2>;  

    C1: child@1 {
        compatible = "child,simple-fields";

        field-str = "field";
        field-u32 = <32>;
        field-u64 = <0xf 0x1>;
        field-strlst = "str1", "str2", "str3";
    };

    C2: child@2 {
        compatible = "child,encoded-array";
        reg = <0x12345 0x1 0x2>;

        mixed_array = <&C1 1 3 5 7>, <&C3 2 4 6 8>;
    };

    C3: child@3 {
        compatible = "child,flags";
        dma-coherent;

        status = "disabled";
        interrupt-controller;
    };
};